## part-3/meta-yadro-hello/conf/layer.conf
```bitbake
BBPATH .= "/home/sonya/poky/meta-yadro-hello"


BBFILES += "/home/sonya/poky/meta-yadro-hello/recipes-*/*/*.bb \
            /home/sonya/poky/meta-yadro-hello/recipes-*/*/*.bbappend"

BBFILE_COLLECTIONS += "yadro-hello"
BBFILE_PATTERN_yadro-hello = "^/home/sonya/poky/meta-yadro-hello/"
BBFILE_PRIORITY_yadro-hello = "5"
LAYERVERSION_yadro-hello = "4"
LAYERSERIES_COMPAT_yadro-hello = "kirkstone"
```
